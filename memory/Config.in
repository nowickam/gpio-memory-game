## memory/Config.in
```kconfig
config BR2_PACKAGE_MEMORY
	bool "memory"
	depends on BR2_PACKAGE_LIBGPIOD
	depends on BR2_PACKAGE_LIBGPIOD_TOOLS
	help
		Memory game on LEDs and buttons from GPIO - libgpiod enables the interaction with the game
```
